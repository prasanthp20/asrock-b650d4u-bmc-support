## docs/experiments/03-pinctrl-lifecycle-kasan/reproduce/ramdisk.its
```
/dts-v1/;

/ {
	description = "B650D4U KASAN test ramdisk";
	#address-cells = <1>;

	images {
		ramdisk {
			description = "Minimal lifecycle test userspace";
			data = /incbin/("initramfs.cpio");
			type = "ramdisk";
			arch = "arm";
			os = "linux";
			compression = "none";

			hash {
				algo = "sha256";
			};
		};
	};

	configurations {
		default = "conf";

		conf {
			description = "KASAN lifecycle test";
			ramdisk = "ramdisk";
		};
	};
};
```

## meta-b650d4u/conf/layer.conf
```bitbake
BBPATH .= ":${LAYERDIR}"
BBFILES += "${LAYERDIR}/recipes-*/*/*.bb \
            ${LAYERDIR}/recipes-*/*/*.bbappend"

BBFILE_COLLECTIONS += "b650d4u"
BBFILE_PATTERN_b650d4u = "^${LAYERDIR}/"
BBFILE_PRIORITY_b650d4u = "5"
LAYERSERIES_COMPAT_b650d4u = "wrynose scarthgap nanbield Mickledore langdale kirkstone"
```

## meta-b650d4u/conf/local.conf
```bitbake
EXTERNALSRC:pn-u-boot = "/home/prasanth/u-boot"
EXTERNALSRC_BUILD:pn-u-boot = "/home/prasanth/u-boot"
```

## meta-b650d4u/conf/machine/b650d4u.conf
```bitbake
KMACHINE = "aspeed"
#KERNEL_DEVICETREE = "aspeed/aspeed-g6.dtb"
KERNEL_DEVICETREE = "aspeed/aspeed-bmc-asrock-b650d4u.dtb"

#UBOOT_MACHINE = "ast2600_openbmc_spl_defconfig"
#UBOOT_MACHINE = "evb-ast2600_defconfig"
#UBOOT_DEVICETREE = "ast2600-evb"
#PREFERRED_PROVIDER_virtual/bootloader = "u-boot-aspeed"
#PREFERRED_PROVIDER_virtual/bootloader = "u-boot-aspeed-sdk"
#OTPTOOL_CONFIGS = "dummy"

UBOOT_MACHINE = "b650d4u_defconfig"
UBOOT_DEVICETREE = "ast2600-b650d4u"

#UBOOT_MACHINE = "evb-ast2600a1-spl_defconfig"
#UBOOT_DEVICETREE = "ast2600a1-evb"

#PREFERRED_PROVIDER_virtual/bootloader = "u-boot-aspeed-sdk"

PREFERRED_PROVIDER_virtual/bootloader = "u-boot"
PREFERRED_PROVIDER_u-boot = "u-boot"
OTPTOOL_CONFIGS = "dummy"
SOCSEC_SIGN_ENABLE = "0"

require conf/machine/include/ast2600.inc
require conf/machine/include/obmc-bsp-common.inc
require conf/machine/include/asrock.inc
require conf/distro/include/pldm.inc

MACHINEOVERRIDES =. "aspeed:ast2600:"

FLASH_SIZE = "65536"
#FLASH_KERNEL_OFFSET = "2048"
FLASH_KERNEL_OFFSET:flash-65536 = "2048"
FLASH_KERNEL_OFFSET:flash-131072 = "2048"
FLASH_UBOOT_ENV_OFFSET = "512"
FLASH_KERNEL_OFFSET = "2048"
#FLASH_KERNEL_OFFSET = "2048"
FLASH_KERNEL_OFFSET_force = "2048"
FLASH_ROFS_OFFSET = "12288"

# UART5 is the physical BMC console and is enumerated as ttyS0 because it is
# the only enabled Linux serial console.
SERIAL_CONSOLES = "115200;ttyS0"




MACHINE_FEATURES += " \
        obmc-phosphor-fan-mgmt \
        obmc-phosphor-chassis-mgmt \
        obmc-phosphor-flash-mgmt \
        obmc-chassis-state-mgmt \
        obmc-bmc-state-mgmt \
        "

PREFERRED_PROVIDER_virtual/obmc-chassis-mgmt = "packagegroup-b650d4u-apps"
PREFERRED_PROVIDER_virtual/obmc-fan-mgmt = "packagegroup-b650d4u-apps"
PREFERRED_PROVIDER_virtual/obmc-flash-mgmt = "packagegroup-b650d4u-apps"
PREFERRED_PROVIDER_virtual/obmc-system-mgmt = "packagegroup-b650d4u-apps"
```
